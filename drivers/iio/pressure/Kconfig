## drivers/iio/pressure/Kconfig
```kconfig
#
# Pressure drivers
#
# When adding new entries keep the list in alphabetical order

menu "Pressure sensors"

config MPL3115
	tristate "Freescale MPL3115A2 pressure sensor driver"
	depends on I2C
	select IIO_BUFFER
	select IIO_TRIGGERED_BUFFER
	help
	  Say yes here to build support for the Freescale MPL3115A2
	  pressure sensor / altimeter.

          To compile this driver as a module, choose M here: the module
          will be called mpl3115.

config IIO_ST_PRESS
	tristate "STMicroelectronics pressure sensor Driver"
	depends on (I2C || SPI_MASTER) && SYSFS
	select IIO_ST_SENSORS_CORE
	select IIO_ST_PRESS_I2C if (I2C)
	select IIO_ST_PRESS_SPI if (SPI_MASTER)
	select IIO_TRIGGERED_BUFFER if (IIO_BUFFER)
	help
	  Say yes here to build support for STMicroelectronics pressure
	  sensors: LPS001WP, LPS331AP.

	  This driver can also be built as a module. If so, these modules
	  will be created:
	  - st_pressure (core functions for the driver [it is mandatory]);
	  - st_pressure_i2c (necessary for the I2C devices [optional*]);
	  - st_pressure_spi (necessary for the SPI devices [optional*]);

	  (*) one of these is necessary to do something.

config IIO_ST_PRESS_I2C
	tristate
	depends on IIO_ST_PRESS
	depends on IIO_ST_SENSORS_I2C

config IIO_ST_PRESS_SPI
	tristate
	depends on IIO_ST_PRESS
	depends on IIO_ST_SENSORS_SPI

config ST_LPS22HB_IIO
	tristate "STMicroelectronics LPS22HB/LPS22HD sensor"
	depends on (I2C || SPI_MASTER) && SYSFS
	select IIO_BUFFER
	select IIO_KFIFO_BUF
	select ST_LPS22HB_I2C_IIO if (I2C)
	select ST_LPS22HB_SPI_IIO if (SPI)
	help
	  This driver supports LPS22HB/LPS22HD sensors. This driver can be
	  built as a module. The module will be called st-lps22hb.

config ST_LPS22HB_I2C_IIO
	tristate
	depends on ST_LPS22HB_IIO

config ST_LPS22HB_SPI_IIO
	tristate
	depends on ST_LPS22HB_IIO

config ST_LPS33HW_IIO
	tristate "STMicroelectronics LPS33HW/LPS35HW sensor"
	depends on (I2C || SPI_MASTER) && SYSFS
	select IIO_BUFFER
	select IIO_KFIFO_BUF
	select ST_LPS33HW_I2C_IIO if (I2C)
	select ST_LPS33HW_SPI_IIO if (SPI)
	help
	  This driver supports LPS33HW/LPS35HW sensors. This driver can be
	  built as a module. The module will be called st-lps33hw.

config ST_LPS33HW_I2C_IIO
	tristate
	depends on ST_LPS33HW_IIO

config ST_LPS33HW_SPI_IIO
	tristate
	depends on ST_LPS33HW_IIO

config ST_LPS22HH_IIO
	tristate "STMicroelectronics LPS22HH/LPS27HHW sensor"
	depends on (I2C || SPI_MASTER) && SYSFS
	select IIO_BUFFER
	select IIO_KFIFO_BUF
	select ST_LPS22HH_I2C_IIO if (I2C)
	select ST_LPS22HH_SPI_IIO if (SPI)
	help
	  This driver supports LPS22HH sensors. This driver can be
	  built as a module. The module will be called st-lps22hh.

config ST_LPS22HH_I2C_IIO
	tristate
	depends on ST_LPS22HH_IIO

config ST_LPS22HH_SPI_IIO
	tristate
	depends on ST_LPS22HH_IIO

config ST_LPS22DF_IIO
	tristate "STMicroelectronics LPS22DF sensor"
	depends on (I2C || SPI_MASTER) && SYSFS
	select IIO_BUFFER
	select IIO_KFIFO_BUF
	select ST_LPS22DF_I2C_IIO if (I2C)
	select ST_LPS22DF_SPI_IIO if (SPI)
	help
          Say yes here to build support for the ST MEMS LPS22DF pressure and
	  temperature  sensor.

	  This driver can be built as a module. The module will be called
	  st-lps22df.

config ST_LPS22DF_I2C_IIO
	tristate
	depends on ST_LPS22DF_IIO

config ST_LPS22DF_SPI_IIO
	tristate
	depends on ST_LPS22DF_IIO

endmenu
```

## drivers/iio/temperature/Kconfig
```kconfig
#
# Temperature sensor drivers
#
menu "Temperature sensors"

source "drivers/iio/temperature/hts221/Kconfig"

config IIO_STTS22H
	tristate "STTS22H ST MEMS temperature sensor"
	depends on I2C
	help
	  If you say yes here you get support for STTS22H ST MEMS I2C
	  temperature sensor.

	  This driver can also be built as a module. If so, the module
	  will be called stts22h.

endmenu
```
